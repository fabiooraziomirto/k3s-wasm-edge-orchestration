## CMakeLists.txt
```
# SPDX-License-Identifier: Apache-2.0

cmake_minimum_required(VERSION 3.20.0)

find_package(Zephyr REQUIRED HINTS $ENV{ZEPHYR_BASE})
project(wasmbed)

# WAMR integration
set(WAMR_ROOT ${CMAKE_CURRENT_SOURCE_DIR}/../wamr)
set(WAMR_BUILD_PLATFORM "zephyr")

# Configure WAMR build for ARM Cortex-M
if(CMAKE_SYSTEM_PROCESSOR MATCHES "arm")
    set(WAMR_BUILD_TARGET "THUMB")
else()
    set(WAMR_BUILD_TARGET "X86_32")
endif()

# WAMR build options
set(WAMR_BUILD_INTERP 1)
set(WAMR_BUILD_AOT 0)
set(WAMR_BUILD_JIT 0)
set(WAMR_BUILD_FAST_JIT 0)
set(WAMR_BUILD_LIBC_BUILTIN 1)
set(WAMR_BUILD_LIBC_WASI 1)
set(WAMR_BUILD_MULTI_MODULE 1)
set(WAMR_BUILD_FAST_INTERP 1)

# Instruction metering: WAMR's equivalent of Wasmtime's fuel API. Exposes
# wasm_runtime_set_instruction_count_limit() so wamr_integration.c can cap
# execution by instruction count (deterministic, host-speed-independent)
# instead of only wall-clock time. See doc/energy-tracking-assessment.md.
# Verify after a clean build that this flag actually produced the API:
#   grep -r WASM_ENABLE_INSTRUCTION_METERING build/wasmbed/zephyr/include/generated/
# If the vendored WAMR revision predates this option, the flag is simply
# unused by runtime_lib.cmake and wamr_integration.c's own
# `#if WASM_ENABLE_INSTRUCTION_METERING` guard keeps the build working
# without it (metering silently compiles out).
set(WAMR_BUILD_INSTRUCTION_METERING 1)

# Global heap configuration: disabilitato — usiamo Alloc_With_Pool in wamr_init()
# Non definire WAMR_BUILD_GLOBAL_HEAP_POOL per evitare di allocare un BSS statico
# duplicato da 128 KB dentro WAMR stesso.

# Zephyr 3.5 does not define IP_TTL / IP_MULTICAST_TTL in <net/socket.h>.
# WAMR's zephyr_socket.c references them unconditionally when LIBC_WASI is on.
# Provide the standard Linux values so the code compiles; the setsockopt calls
# will return ENOSYS at runtime on Zephyr (TTL is not a supported socket option).
if(WAMR_BUILD_LIBC_WASI)
    add_compile_definitions(IP_TTL=2 IP_MULTICAST_TTL=33)
endif()

# Include WAMR build script
set(WAMR_ROOT_DIR ${WAMR_ROOT})
include(${WAMR_ROOT}/build-scripts/runtime_lib.cmake)

# Add WAMR sources to app
target_sources(app PRIVATE ${WAMR_RUNTIME_LIB_SOURCE})

# Include directories
target_include_directories(app PRIVATE ${WAMR_ROOT}/core/iwasm/include)

target_sources(app PRIVATE
    src/main.c
    src/wamr_integration.c
    src/wasmbed_protocol.c
)

# Network stack
target_sources(app PRIVATE
    src/network_handler.c
)

# WAMR sources are included directly in the app target
```

## prj.conf
```kconfig
# SPDX-License-Identifier: Apache-2.0
# Zephyr configuration for Wasmbed application
# Based on working dhcpv4_client sample

# Required by WAMR_BUILD_LIBC_WASI=1 (zephyr-app/CMakeLists.txt) on Zephyr.
# Confirmed 2026-07-28 on the first real build attempt against this
# prj.conf (Zephyr v3.7.0 + WAMR): without CONFIG_REQUIRES_FULL_LIBC, the
# WASI layer's own posix.c fails to compile ("invalid use of incomplete
# typedef 'os_timespec'" / "storage size of 'ts' isn't known") because
# Zephyr's minimal libc doesn't provide a complete `struct timespec`.
# Without CONFIG_FILE_SYSTEM(_LITTLEFS), WAMR's zephyr_file.c (which
# unconditionally includes <zephyr/fs/littlefs.h>) fails with
# "lfs.h: No such file or directory" -- that header is only wired to the
# real littlefs library when the fs subsystem is enabled. Both are set in
# WAMR's own official Zephyr+WASI sample
# (wamr/product-mini/platforms/zephyr/simple-file/prj.conf), confirming
# this is a genuinely required pairing, not a version-specific workaround.
CONFIG_REQUIRES_FULL_LIBC=y
CONFIG_FILE_SYSTEM=y
CONFIG_FILE_SYSTEM_LITTLEFS=y

# Network stack (from dhcpv4_client - working configuration)
CONFIG_NETWORKING=y
CONFIG_NET_IPV4=y
CONFIG_NET_TCP=y
CONFIG_NET_SOCKETS=y
CONFIG_NET_DHCPV4=y
# Needed by NET_REQUEST_ETHERNET_SET_MAC_ADDRESS: each emulated instance is
# given its own MAC at boot (see apply_injected_mac in network_handler.c),
# otherwise the whole fleet shares the driver's built-in address and one lease.
CONFIG_NET_L2_ETHERNET_MGMT=y
CONFIG_NET_MGMT=y
CONFIG_NET_MGMT_EVENT=y

# Random number generator (required for network stack)
CONFIG_TEST_RANDOM_GENERATOR=y
CONFIG_ENTROPY_GENERATOR=y

# Logging (from dhcpv4_client - working configuration)
CONFIG_NET_LOG=y
CONFIG_LOG=y
# Note: NOT using CONFIG_LOG_MODE_IMMEDIATE - this might cause issues

# Network shell (useful for debugging)
CONFIG_NET_SHELL=y

# TLS support (for Wasmbed)
CONFIG_MBEDTLS=y
CONFIG_MBEDTLS_BUILTIN=y
CONFIG_MBEDTLS_ENABLE_HEAP=y
CONFIG_NET_SOCKETS_SOCKOPT_TLS=y

# Mutual TLS: the device presents a client certificate signed by the fleet CA
# and verifies the gateway against that same CA. Three credentials are
# registered under one security tag (CA, own certificate, private key), see
# network_set_tls_credentials in src/network_handler.c.
CONFIG_TLS_CREDENTIALS=y
CONFIG_TLS_MAX_CREDENTIALS_NUMBER=4

# Proof of possession: the device signs the gateway's enrollment nonce.
# CTR_DRBG + ENTROPY because mbedtls_pk_sign needs an RNG for ECDSA, PK_WRITE
# for the signature encoding. There is deliberately no CONFIG for PK parsing or
# SHA-256: neither MBEDTLS_PK_PARSE_C nor MBEDTLS_SHA256 is a Kconfig symbol
# here (checked against the lab Zephyr 3.5 tree), and both are already provided
# by the TLS profile -- PK_PARSE_C via X509_CRT_PARSE_C in
# modules/mbedtls/configs/config-tls-generic.h, SHA-256 via the
# ...AES_128_GCM_SHA256 cipher suites. Setting an undefined symbol is a hard
# build error, not a no-op.
CONFIG_MBEDTLS_PK_WRITE_C=y
CONFIG_MBEDTLS_CTR_DRBG_ENABLED=y
CONFIG_MBEDTLS_ENTROPY_ENABLED=y
# RFC 6979: derive the ECDSA nonce from the key and message instead of from the
# RNG. This board registers no entropy source with mbedTLS -- seeding a CTR_DRBG
# from mbedtls_entropy_func fails outright -- and under Renode the platform
# generator is CONFIG_TEST_RANDOM_GENERATOR. A repeated or predictable nonce
# would disclose the private key; a deterministic one cannot be.
CONFIG_MBEDTLS_ECDSA_DETERMINISTIC=y
# Prerequisite of the above: RFC 6979 derives the nonce with HMAC-DRBG, and
# mbedTLS refuses to build without it ("MBEDTLS_ECDSA_DETERMINISTIC defined,
# but not all prerequisites").
CONFIG_MBEDTLS_HMAC_DRBG_ENABLED=y

# Enable ECDHE-ECDSA cipher suite (gateway now uses ECDSA P-256 certificate)
# Keep RSA enabled for compatibility during transition
CONFIG_MBEDTLS_KEY_EXCHANGE_RSA_ENABLED=y
CONFIG_MBEDTLS_KEY_EXCHANGE_ECDHE_RSA_ENABLED=y
CONFIG_MBEDTLS_KEY_EXCHANGE_ECDHE_ECDSA_ENABLED=y
CONFIG_MBEDTLS_ECDH_C=y
CONFIG_MBEDTLS_ECDSA_C=y
CONFIG_MBEDTLS_ECP_C=y
CONFIG_MBEDTLS_ECP_DP_SECP256R1_ENABLED=y
CONFIG_MBEDTLS_ECP_DP_SECP384R1_ENABLED=y
CONFIG_MBEDTLS_CIPHER_GCM_ENABLED=y
# The 4 symbols this replaces (MBEDTLS_HASH_SHA384_ENABLED,
# MBEDTLS_HASH_SHA512_ENABLED, MBEDTLS_MAC_SHA384_ENABLED,
# MBEDTLS_MAC_SHA512_ENABLED) do not exist in this Zephyr version's mbedtls
# Kconfig glue (zephyr/modules/mbedtls/Kconfig.tls-generic) -- confirmed
# 2026-07-28 building against Zephyr v3.7.0, the first real build attempt
# against this prj.conf (no Zephyr SDK/workspace existed anywhere before).
# Assigning a value to an undefined Kconfig symbol is a hard build error in
# Zephyr ("Aborting due to Kconfig warnings"), not a silent no-op. The real
# symbols are MBEDTLS_SHA384/MBEDTLS_SHA512 (hash only -- there is no
# separate MAC-specific enable symbol in this Kconfig; HMAC-SHA384/512
# usage is gated solely by the hash algorithm being enabled).
CONFIG_MBEDTLS_SHA384=y
CONFIG_MBEDTLS_SHA512=y

# Memory management
CONFIG_HEAP_MEM_POOL_SIZE=4096

# TLS heap for MbedTLS: RSA-2048 ServerKeyExchange verification needs ~22KB peak
# (SSL buffers 2*4096 + handshake overhead ~10KB, then RSA-2048 MPI ops ~12KB).
# 16KB caused MBEDTLS_ERR_MPI_ALLOC_FAILED; 32KB gives enough headroom.
# It cannot simply be raised for client authentication: on stm32f746g_disco
# CONFIG_SRAM_SIZE is 256KB and 64KB overflowed the RAM region by ~31KB at
# link time. The credential buffers in wasmbed_protocol.c are sized against
# the same budget.
CONFIG_MBEDTLS_HEAP_SIZE=32768

# Increase TLS record buffer: default 1500 is too small for RSA-2048 cert from
# Rustls gateway (cert ~1305 DER bytes + handshake overhead > 1500). Increasing
# to 4096 allows the combined Certificate+ServerKeyExchange record to be parsed.
# The records added by client authentication (CertificateRequest inbound, this
# device's ~550-byte certificate outbound) fit inside the same 4096.
CONFIG_MBEDTLS_SSL_MAX_CONTENT_LEN=4096

# Threading
CONFIG_MULTITHREADING=y

# Main stack size: 4KB needed for WAMR module instantiation (wasm_runtime_instantiate
# calls several layers of internal functions that overflow the 2KB default).
CONFIG_MAIN_STACK_SIZE=4096

# Increase TCP workqueue stack size for TLS ECDHE operations (default 1024 is too small)
CONFIG_NET_TCP_WORKQ_STACK_SIZE=4096

# UART for logging
CONFIG_SERIAL=y
CONFIG_UART_INTERRUPT_DRIVEN=y

# Device drivers
CONFIG_GPIO=y
CONFIG_I2C=y
CONFIG_SPI=y

# POSIX API disabled: struct timespec è già risolto con #include <time.h>
# in platform_internal.h (patch Zephyr 3.5). POSIX_API=y causa eof nei
# TLS handshake Zephyr perché ridefinisce le socket ops in modo incompatibile.
CONFIG_POSIX_API=n

# Enable file system layer so WAMR zephyr_file.c links (fs_stat, fs_open, etc.)
# WAMR WASI includes file ops even when only sockets are used at runtime.
CONFIG_FILE_SYSTEM=y

# Note: NOT disabling MPU - dhcpv4_client works with MPU enabled
# CONFIG_ARM_MPU=n  # Removed - dhcpv4_client works with MPU
```

## src/main.c
```c
/*
 * SPDX-License-Identifier: Apache-2.0
 * Copyright © 2025 Wasmbed contributors
 *
 * Wasmbed Zephyr Application
 * Main entry point for Zephyr RTOS with WAMR integration
 * Based on working dhcpv4_client sample structure
 */

#include <zephyr/kernel.h>
#include <zephyr/logging/log.h>
#include <zephyr/net/net_if.h>
#include <zephyr/net/net_core.h>
#include <zephyr/net/net_mgmt.h>

#include "network_handler.h"
#include "wamr_integration.h"
#include "wasmbed_protocol.h"

LOG_MODULE_REGISTER(wasmbed_main, LOG_LEVEL_INF);

/* Main application thread */
void main(void)
{
    LOG_INF("=== Wasmbed Zephyr Application Starting ===");
    LOG_INF("Zephyr RTOS + WAMR Runtime");

    /* Initialize network stack */
    LOG_INF("Initializing network stack...");
    if (network_init() != 0) {
        LOG_ERR("Failed to initialize network stack - continuing without network");
        /* Continue execution - network might not be available in all configurations */
    } else {
        LOG_INF("Network stack initialized");
    }

    /* Initialize WAMR runtime */
    LOG_INF("Initializing WAMR runtime...");
    if (wamr_init() != 0) {
        LOG_ERR("Failed to initialize WAMR runtime");
        return;
    }
    LOG_INF("WAMR runtime initialized");

    /* Initialize Wasmbed protocol handler */
    LOG_INF("Initializing Wasmbed protocol...");
    if (wasmbed_protocol_init() != 0) {
        LOG_ERR("Failed to initialize Wasmbed protocol");
        return;
    }
    LOG_INF("Wasmbed protocol initialized");

    LOG_INF("=== Wasmbed Application Ready ===");
    LOG_INF("Waiting for WASM modules to deploy...");

    /* Main loop: handle WASM execution and network communication */
    while (1) {
        /* Process network events */
        network_process();

        /* Check for incoming messages from gateway using framed receive.
         * timeout_ms=100 matches k_sleep below; avoids partial-frame drops. */
        wasmbed_protocol_recv_and_handle(100);

        /* Send periodic heartbeat to keep TLS connection alive (Gateway expects it for last_heartbeat) */
        wasmbed_protocol_tick();

        /* Process WASM execution */
        wamr_process();

        /* Yield to other threads */
        k_sleep(K_MSEC(100));
    }
}
```

## src/network_handler.c
```c
/*
 * SPDX-License-Identifier: Apache-2.0
 * Copyright © 2025 Wasmbed contributors
 *
 * Network Handler Implementation
 * Uses Zephyr network stack (TCP/IP, TLS)
 */

#include "network_handler.h"
#include <zephyr/logging/log.h>
#include <zephyr/net/net_if.h>
#include <zephyr/net/net_core.h>
#include <zephyr/net/net_context.h>
#include <zephyr/net/socket.h>
#include <zephyr/net/net_event.h>
#include <zephyr/net/dhcpv4.h>
#include <zephyr/net/ethernet.h>
#include <zephyr/net/ethernet_mgmt.h>
#include <zephyr/kernel.h>
#include <string.h>
#include <errno.h>

/* Use Zephyr socket API (zsock_*) instead of POSIX */
#include <zephyr/net/socket.h>
#include <zephyr/net/tls_credentials.h>

LOG_MODULE_REGISTER(network_handler, LOG_LEVEL_INF);

static bool network_initialized = false;
static int socket_fd = -1;
static struct net_if *net_iface = NULL;

/* Security tag under which this device's TLS credentials are registered. */
#define WASMBED_TLS_SEC_TAG 1

/* Set once network_set_tls_credentials has registered a full credential set.
 * Until then the socket falls back to an unauthenticated handshake. */
static bool tls_credentials_ready = false;

/* Memory address where Renode writes this device's MAC address
 * (4-byte LE length, then the address bytes), mirroring the gateway endpoint
 * and public key injections in wasmbed_protocol.c. */
#define DEVICE_MAC_ADDR 0x20002100

/* Program the injected MAC before DHCP runs.
 * The Ethernet driver otherwise keeps its built-in address, which is identical
 * in every emulated instance: the whole fleet then asks for -- and shares -- one
 * DHCP lease, so return traffic follows whichever device last answered ARP. */
static void apply_injected_mac(struct net_if *iface)
{
    volatile uint32_t *len_ptr = (volatile uint32_t *)DEVICE_MAC_ADDR;
    uint32_t len = *len_ptr;
    uint8_t mac[6];

    if (len != sizeof(mac)) {
        LOG_WRN("No MAC injected (len=%u), keeping the driver default", len);
        return;
    }

    volatile uint8_t *mac_ptr = (volatile uint8_t *)(DEVICE_MAC_ADDR + 4);
    for (uint32_t i = 0; i < sizeof(mac); i++) {
        mac[i] = mac_ptr[i];
    }

    /* Go through the Ethernet management API, not net_if_set_link_addr(): the
     * latter only changes what the IP stack believes, while the driver keeps
     * programming the controller's address filter with its own built-in MAC.
     * Frames addressed to the new MAC would then be dropped by the NIC and DHCP
     * would never complete. The interface must be down for the change. */
    struct ethernet_req_params params = {0};
    memcpy(params.mac_address.addr, mac, sizeof(mac));

    net_if_down(iface);
    int ret = net_mgmt(NET_REQUEST_ETHERNET_SET_MAC_ADDRESS, iface,
                       &params, sizeof(params));
    if (ret != 0) {
        LOG_ERR("Cannot set injected MAC %02x:%02x:%02x:%02x:%02x:%02x (err %d)",
                mac[0], mac[1], mac[2], mac[3], mac[4], mac[5], ret);
        /* Fall back to the stack-level address: better than the shared default. */
        (void)net_if_set_link_addr(iface, mac, sizeof(mac), NET_LINK_ETHERNET);
        return;
    }

    LOG_INF("Using injected MAC %02x:%02x:%02x:%02x:%02x:%02x",
            mac[0], mac[1], mac[2], mac[3], mac[4], mac[5]);
}

static int configure_static_ipv4_fallback(void)
{
    struct in_addr addr;
    struct in_addr netmask;
    struct in_addr gateway;

    if (net_iface == NULL) {
        return -1;
    }

    if (net_addr_pton(AF_INET, "192.168.1.2", &addr) < 0 ||
        net_addr_pton(AF_INET, "255.255.255.0", &netmask) < 0 ||
        net_addr_pton(AF_INET, "192.168.1.1", &gateway) < 0) {
        LOG_ERR("Static IPv4 fallback parse failed");
        return -1;
    }

    if (!net_if_ipv4_addr_add(net_iface, &addr, NET_ADDR_MANUAL, 0)) {
        LOG_ERR("Cannot set static IPv4 fallback address");
        return -1;
    }

    net_if_ipv4_set_netmask(net_iface, &netmask);
    net_if_ipv4_set_gw(net_iface, &gateway);
    LOG_INF("Static IPv4 fallback configured: 192.168.1.2/24 gw 192.168.1.1");
    return 0;
}

/* Initialize network stack */
int network_init(void)
{
    if (network_initialized) {
        LOG_WRN("Network already initialized");
        return 0;
    }

    LOG_INF("Initializing network stack...");

    /* Get default network interface */
    /* Wait a bit for network interface to be available */
    int retries = 10;
    while (retries > 0) {
        net_iface = net_if_get_default();
        if (net_iface != NULL) {
            break;
        }
        LOG_WRN("Network interface not available yet, retrying... (%d)", retries);
        k_sleep(K_MSEC(500));
        retries--;
    }
    
    if (net_iface == NULL) {
        LOG_ERR("No network interface available after retries");
        /* Don't fail - allow firmware to continue without network */
        LOG_WRN("Continuing without network interface");
        return -1;
    }

    /* Give this instance its own link-layer identity before anything uses it */
    apply_injected_mac(net_iface);

    /* Bring interface up */
    if (!net_if_is_up(net_iface)) {
        net_if_up(net_iface);
        LOG_INF("Network interface brought up");
    }

    /* Start DHCP client if available */
#if defined(CONFIG_NET_DHCPV4)
    net_dhcpv4_start(net_iface);
    LOG_INF("DHCP client started");

    /* Wait for DHCP to assign an IP address (up to 120 seconds) */
    {
        int dhcp_wait = 120;
        bool got_ip = false;
        while (dhcp_wait > 0) {
            struct net_if_addr *unicast;
            struct net_if_ipv4 *ipv4 = net_iface->config.ip.ipv4;
            if (ipv4 != NULL) {
                for (int i = 0; i < NET_IF_MAX_IPV4_ADDR; i++) {
                    unicast = &ipv4->unicast[i];
                    if (unicast->is_used &&
                        unicast->addr_state == NET_ADDR_PREFERRED &&
                        unicast->addr_type == NET_ADDR_DHCP) {
                        got_ip = true;
                        break;
                    }
                }
            }
            if (got_ip) {
                break;
            }
            k_sleep(K_SECONDS(1));
            dhcp_wait--;
            if (dhcp_wait % 10 == 0) {
                LOG_INF("Waiting for DHCP... (%d s remaining)", dhcp_wait);
            }
        }
        if (got_ip) {
            LOG_INF("DHCP address acquired");
        } else {
            LOG_WRN("DHCP timeout - applying static IPv4 fallback");
            if (configure_static_ipv4_fallback() != 0) {
                LOG_WRN("Static IPv4 fallback failed - proceeding without IP");
            }
        }
    }
#else
    /* Static IP configuration would go here */
    LOG_INF("Using static IP configuration (DHCP disabled)");
    k_sleep(K_SECONDS(2));
#endif

    network_initialized = true;
    LOG_INF("Network stack initialized");

    return 0;
}

/* Process network events */
void network_process(void)
{
    if (!network_initialized) {
        return;
    }

    /* Network event processing is handled by Zephyr network stack automatically
     * This function can be used for custom event handling if needed */
    
    /* Check if interface is still up */
    if (net_iface != NULL && !net_if_is_up(net_iface)) {
        LOG_WRN("Network interface is down");
    }
}

/* Connect to gateway */
int network_connect(const char *host, uint16_t port)
{
    if (!network_initialized) {
        LOG_ERR("Network not initialized");
        return -1;
    }

    LOG_INF("Connecting to gateway: %s:%u", host, port);

    /* Close existing socket if any */
    if (socket_fd >= 0) {
        zsock_close(socket_fd);
        socket_fd = -1;
    }

    /* Create TCP socket */
    socket_fd = zsock_socket(AF_INET, SOCK_STREAM, IPPROTO_TCP);
    if (socket_fd < 0) {
        LOG_ERR("Failed to create socket: %d", errno);
        return -1;
    }

    /* Setup address structure */
    struct sockaddr_in addr;
    memset(&addr, 0, sizeof(addr));
    addr.sin_family = AF_INET;
    addr.sin_port = htons(port);

    /* Resolve hostname to IP (simplified - assumes IP address string) */
    if (net_addr_pton(AF_INET, host, &addr.sin_addr) < 0) {
        LOG_ERR("Invalid IP address: %s", host);
        zsock_close(socket_fd);
        socket_fd = -1;
        return -1;
    }

    /* Connect to server */
    if (zsock_connect(socket_fd, (struct sockaddr *)&addr, sizeof(addr)) < 0) {
        LOG_ERR("Failed to connect: %d", errno);
        zsock_close(socket_fd);
        socket_fd = -1;
        return -1;
    }

    LOG_INF("Connected to gateway: %s:%u", host, port);

    return 0;
}

/* Register the fleet CA and this device's own certificate and key. */
int network_set_tls_credentials(const uint8_t *ca, uint32_t ca_len,
                                const uint8_t *cert, uint32_t cert_len,
                                const uint8_t *key, uint32_t key_len)
{
    int ret;

    if (ca == NULL || ca_len == 0 || cert == NULL || cert_len == 0 ||
        key == NULL || key_len == 0) {
        LOG_ERR("Incomplete TLS credentials (ca=%u cert=%u key=%u bytes)",
                ca_len, cert_len, key_len);
        return -1;
    }

    /* Credentials are DER, which tls_credential_add takes as-is. */
    ret = tls_credential_add(WASMBED_TLS_SEC_TAG, TLS_CREDENTIAL_CA_CERTIFICATE,
                             ca, ca_len);
    if (ret != 0 && ret != -EEXIST) {
        LOG_ERR("Failed to add CA certificate: %d", ret);
        return -1;
    }

    /* Zephyr uses TLS_CREDENTIAL_SERVER_CERTIFICATE for the socket's own
     * certificate, on a client socket too. */
    ret = tls_credential_add(WASMBED_TLS_SEC_TAG, TLS_CREDENTIAL_SERVER_CERTIFICATE,
                             cert, cert_len);
    if (ret != 0 && ret != -EEXIST) {
        LOG_ERR("Failed to add client certificate: %d", ret);
        return -1;
    }

    ret = tls_credential_add(WASMBED_TLS_SEC_TAG, TLS_CREDENTIAL_PRIVATE_KEY,
                             key, key_len);
    if (ret != 0 && ret != -EEXIST) {
        LOG_ERR("Failed to add private key: %d", ret);
        return -1;
    }

    tls_credentials_ready = true;
    LOG_INF("TLS credentials registered (ca=%u cert=%u key=%u bytes)",
            ca_len, cert_len, key_len);
    return 0;
}

/* Connect to gateway with TLS */
int network_connect_tls(const char *host, uint16_t port)
{
    if (!network_initialized) {
        LOG_ERR("Network not initialized");
        return -1;
    }

    LOG_INF("Connecting to gateway with TLS: %s:%u", host, port);

    /* Close existing socket if any */
    if (socket_fd >= 0) {
        zsock_close(socket_fd);
        socket_fd = -1;
    }

    /* Create TLS socket */
    socket_fd = zsock_socket(AF_INET, SOCK_STREAM, IPPROTO_TLS_1_2);
    if (socket_fd < 0) {
        LOG_ERR("Failed to create TLS socket: %d", errno);
        return -1;
    }

    /* Present this device's certificate and check the gateway's against the
     * fleet CA. Without credentials neither side is authenticated, so the
     * device cannot tell the real gateway from anything that answers on that
     * address; keep that path only so a board can boot before it has been
     * provisioned, and say so plainly. */
    int verify = TLS_PEER_VERIFY_REQUIRED;
    if (tls_credentials_ready) {
        sec_tag_t sec_tag_list[] = { WASMBED_TLS_SEC_TAG };
        if (zsock_setsockopt(socket_fd, SOL_TLS, TLS_SEC_TAG_LIST,
                             sec_tag_list, sizeof(sec_tag_list)) < 0) {
            LOG_ERR("Failed to set TLS_SEC_TAG_LIST: %d", errno);
            zsock_close(socket_fd);
            socket_fd = -1;
            return -1;
        }
    } else {
        LOG_WRN("No TLS credentials provisioned: the gateway will not be "
                "authenticated and this device cannot authenticate itself");
        verify = TLS_PEER_VERIFY_NONE;
    }
    if (zsock_setsockopt(socket_fd, SOL_TLS, TLS_PEER_VERIFY, &verify, sizeof(verify)) < 0) {
        LOG_WRN("Failed to set TLS_PEER_VERIFY: %d", errno);
    }

    /* Set send/connect timeout to 30 seconds to avoid blocking indefinitely */
    struct zsock_timeval tv = { .tv_sec = 30, .tv_usec = 0 };
    if (zsock_setsockopt(socket_fd, SOL_SOCKET, SO_SNDTIMEO, &tv, sizeof(tv)) < 0) {
        LOG_WRN("Failed to set SO_SNDTIMEO: %d", errno);
    }
    if (zsock_setsockopt(socket_fd, SOL_SOCKET, SO_RCVTIMEO, &tv, sizeof(tv)) < 0) {
        LOG_WRN("Failed to set SO_RCVTIMEO: %d", errno);
    }

    /* Setup address structure */
    struct sockaddr_in addr;
    memset(&addr, 0, sizeof(addr));
    addr.sin_family = AF_INET;
    addr.sin_port = htons(port);

    /* Resolve hostname to IP */
    if (net_addr_pton(AF_INET, host, &addr.sin_addr) < 0) {
        LOG_ERR("Invalid IP address: %s", host);
        zsock_close(socket_fd);
        socket_fd = -1;
        return -1;
    }

    /* Always name the peer we expect, including when the endpoint is an IP
     * literal as it is under Renode.
     *
     * Leaving it unset does not mean "skip the name check": Zephyr sets the
     * verified name to the empty string for clients that configured none
     * (sockets_tls.c), so that verification cannot silently pass without one.
     * Nothing matches the empty string, and the handshake fails with
     * MBEDTLS_ERR_X509_CERT_VERIFY_FAILED against a certificate that verifies
     * cleanly elsewhere.
     *
     * The gateway certificate carries each address as a dNSName as well as an
     * iPAddress, because mbedTLS only matches dNSName entries. Zephyr expects
     * the trailing NUL, as in its own TLS clients. */
    if (zsock_setsockopt(socket_fd, SOL_TLS, TLS_HOSTNAME, host, strlen(host) + 1) < 0) {
        LOG_WRN("Failed to set TLS_HOSTNAME: %d", errno);
    }

    /* Connect to server (TLS handshake happens during connect) */
    if (zsock_connect(socket_fd, (struct sockaddr *)&addr, sizeof(addr)) < 0) {
        LOG_ERR("Failed to connect: %d", errno);
        zsock_close(socket_fd);
        socket_fd = -1;
        return -1;
    }

    LOG_INF("Connected to gateway with TLS: %s:%u", host, port);

    return 0;
}

/* Send data via network */
int network_send(const uint8_t *data, uint32_t data_len)
{
    if (socket_fd < 0) {
        LOG_ERR("Socket not connected");
        return -1;
    }

    ssize_t sent = zsock_send(socket_fd, data, data_len, 0);
    if (sent < 0) {
        LOG_ERR("Failed to send data: %d", errno);
        return -1;
    }

    if (sent != (ssize_t)data_len) {
        LOG_WRN("Partial send: %zd/%u bytes", sent, data_len);
    }

    return 0;
}

/* Receive data from network */
int network_receive(uint8_t *buffer, uint32_t buffer_len, uint32_t *received_len)
{
    if (socket_fd < 0) {
        LOG_ERR("Socket not connected");
        return -1;
    }

    ssize_t received = zsock_recv(socket_fd, buffer, buffer_len, 0);
    if (received < 0) {
        if (errno == EAGAIN || errno == EWOULDBLOCK) {
            /* No data available */
            *received_len = 0;
            return 0;
        }
        LOG_ERR("Failed to receive data: %d", errno);
        return -1;
    }

    *received_len = (uint32_t)received;
    return 0;
}

/* Poll socket for incoming data; returns >0 if readable, 0 on timeout, <0 on error */
int network_poll_readable(int timeout_ms)
{
    if (socket_fd < 0) {
        return -1;
    }
    struct zsock_pollfd pfd;
    pfd.fd     = socket_fd;
    pfd.events = ZSOCK_POLLIN;
    pfd.revents = 0;
    return zsock_poll(&pfd, 1, timeout_ms);
}

/* Receive a framed message: 4-byte BE length header + payload.
 * Uses individual recv calls for header and payload. */
int network_receive_framed(uint8_t *buffer, uint32_t buffer_len, uint32_t *received_len)
{
    if (socket_fd < 0) {
        return -1;
    }

    *received_len = 0;

    /* Read 4-byte length header — single blocking recv */
    ssize_t r = zsock_recv(socket_fd, buffer, 4, 0);
    if (r <= 0) {
        return -1;
    }
    /* Handle partial header read by accumulating */
    uint32_t hdr_got = (uint32_t)r;
    while (hdr_got < 4) {
        r = zsock_recv(socket_fd, buffer + hdr_got, 4 - hdr_got, 0);
        if (r <= 0) {
            return -1;
        }
        hdr_got += (uint32_t)r;
    }

    uint32_t payload_len = ((uint32_t)buffer[0] << 24) |
                           ((uint32_t)buffer[1] << 16) |
                           ((uint32_t)buffer[2] <<  8) |
                           ((uint32_t)buffer[3]);

    if (4 + payload_len > buffer_len) {
        LOG_ERR("Frame too large: %u bytes", payload_len);
        return -1;
    }

    /* Read payload — accumulate until complete */
    uint32_t got = 0;
    while (got < payload_len) {
        r = zsock_recv(socket_fd, buffer + 4 + got, payload_len - got, 0);
        if (r <= 0) {
            return -1;
        }
        got += (uint32_t)r;
    }

    *received_len = 4 + payload_len;
    return 0;
}
```

## src/network_handler.h
```c
/*
 * SPDX-License-Identifier: Apache-2.0
 * Copyright © 2025 Wasmbed contributors
 *
 * Network Handler
 * TCP/IP and TLS communication
 */

#ifndef NETWORK_HANDLER_H
#define NETWORK_HANDLER_H

#include <stdint.h>

/* Initialize network stack */
int network_init(void);

/* Process network events */
void network_process(void);

/* Connect to gateway */
int network_connect(const char *host, uint16_t port);

/* Register the device's TLS credentials before connecting.
 * ca is the fleet CA the gateway's certificate is checked against; cert and key
 * are this device's own client certificate and PKCS#8 private key.
 * Returns 0 on success. Without this the connection is anonymous in both
 * directions and neither side knows who it is talking to. */
int network_set_tls_credentials(const uint8_t *ca, uint32_t ca_len,
                                const uint8_t *cert, uint32_t cert_len,
                                const uint8_t *key, uint32_t key_len);

/* Connect to gateway with TLS */
int network_connect_tls(const char *host, uint16_t port);

/* Send data via network */
int network_send(const uint8_t *data, uint32_t data_len);

/* Receive data from network */
int network_receive(uint8_t *buffer, uint32_t buffer_len, uint32_t *received_len);

/* Poll the socket for readability; returns >0 if data available within timeout_ms, 0 on timeout, <0 on error. */
int network_poll_readable(int timeout_ms);

/* Receive a length-prefixed framed message (4-byte BE header + CBOR payload).
 * buffer receives the full frame (header + payload), buffer_len is the max size.
 * received_len is set to total bytes read (header + payload). */
int network_receive_framed(uint8_t *buffer, uint32_t buffer_len, uint32_t *received_len);

#endif /* NETWORK_HANDLER_H */
```

## src/wamr_integration.c
```c
/*
 * SPDX-License-Identifier: Apache-2.0
 * Copyright © 2025 Wasmbed contributors
 *
 * WAMR Integration Layer Implementation
 */

#include "wamr_integration.h"
#include <zephyr/logging/log.h>
#include "wasm_export.h"
#include <string.h>

LOG_MODULE_REGISTER(wamr_integration, LOG_LEVEL_INF);

/* WAMR runtime state */
static bool wamr_initialized = false;

/* WAMR heap buffer: pool passato a wasm_runtime_full_init (Alloc_With_Pool).
 * Con WAMR_BUILD_LIBC_WASI=1, WASI aggiunge ~10-15 KB di overhead interno
 * (fd table, environ, args) rispetto al baseline senza WASI.
 * 128 KB: linear memory (1 page=64KB) + exec stack (16KB) + instance overhead (~10KB).
 * Sul target STM32F746 non c'e' headroom sufficiente per aumentarlo ulteriormente. */
#define WAMR_HEAP_SIZE (128 * 1024)
static uint8_t wamr_heap_buffer[WAMR_HEAP_SIZE] __aligned(8);

/* Module registry */
#define MAX_MODULES 16
#define MAX_INSTANCES 16

typedef struct {
    uint32_t id;
    wasm_module_t module;
    bool in_use;
} module_entry_t;

typedef struct {
    uint32_t id;
    wasm_module_inst_t instance;
    wasm_exec_env_t exec_env;
    bool in_use;
    /* True once a call on this instance has failed by hitting
     * WAMR_INSTRUCTION_LIMIT (see wamr_last_call_hit_instruction_limit). */
    bool instruction_limit_hit;
} instance_entry_t;

static module_entry_t modules[MAX_MODULES];
static instance_entry_t instances[MAX_INSTANCES];
static uint32_t next_module_id = 1;
static uint32_t next_instance_id = 1;

/* Fixed per-instance instruction budget, WAMR_BUILD_INSTRUCTION_METERING
 * required (see CMakeLists.txt). Same order of magnitude as the MCU fuel
 * budget in crates/wasmbed-wasm-runtime/src/config.rs (5_000_000) so the two
 * runtimes are at least roughly comparable — "one WAMR instruction" and "one
 * Wasmtime fuel unit" are NOT guaranteed equivalent costs, treat any
 * cross-runtime comparison as approximate. See
 * doc/energy-tracking-assessment.md. */
#define WAMR_INSTRUCTION_LIMIT 5000000

/* Substring WAMR is believed to use in the exception message when
 * instruction metering trips (based on the public API's naming, not a
 * verified source read — no vendored WAMR tree or internet access in this
 * sandbox). Deliberately more specific than just "instruction", to avoid
 * false-matching unrelated traps whose message also mentions
 * "instruction" (e.g. an illegal/unreachable instruction trap). The first
 * time this actually fires during a real build, check the logged exception
 * text (LOG_ERR below prints it verbatim) and correct this constant if it
 * doesn't match — do not trust it unverified. */
#define WAMR_INSTRUCTION_LIMIT_EXCEPTION_SUBSTR "instruction limit"

/* Initialize WAMR runtime */
int wamr_init(void)
{
    if (wamr_initialized) {
        LOG_WRN("WAMR already initialized");
        return 0;
    }

    LOG_INF("Initializing WAMR runtime...");
    
    RuntimeInitArgs init_args;
    memset(&init_args, 0, sizeof(RuntimeInitArgs));
    
    /* Use pool memory allocator with static buffer */
    init_args.mem_alloc_type = Alloc_With_Pool;
    init_args.mem_alloc_option.pool.heap_buf = wamr_heap_buffer;
    init_args.mem_alloc_option.pool.heap_size = WAMR_HEAP_SIZE;
    
    /* No native symbols for now */
    init_args.native_symbols = NULL;
    init_args.n_native_symbols = 0;
    
    if (!wasm_runtime_full_init(&init_args)) {
        LOG_ERR("Failed to initialize WAMR runtime");
        return -1;
    }

    /* Initialize module and instance registries */
    memset(modules, 0, sizeof(modules));
    memset(instances, 0, sizeof(instances));

    wamr_initialized = true;
    LOG_INF("WAMR runtime initialized");
    
    return 0;
}

/* Load WASM module from bytes */
int wamr_load_module(const uint8_t *wasm_bytes, uint32_t wasm_size, uint32_t *module_id)
{
    if (!wamr_initialized) {
        LOG_ERR("WAMR not initialized");
        return -1;
    }

    if (wasm_bytes == NULL || wasm_size == 0 || module_id == NULL) {
        LOG_ERR("Invalid parameters");
        return -1;
    }

    LOG_INF("Loading WASM module (size: %u bytes)...", wasm_size);

    /* Find free module slot */
    int slot = -1;
    for (int i = 0; i < MAX_MODULES; i++) {
        if (!modules[i].in_use) {
            slot = i;
            break;
        }
    }
    
    if (slot < 0) {
        LOG_ERR("No free module slots");
        return -1;
    }

    /* Error buffer for WAMR */
    static char error_buf[128];
    error_buf[0] = '\0';

    /* Load WASM module */
    wasm_module_t module = wasm_runtime_load((uint8_t *)wasm_bytes, wasm_size, 
                                            error_buf, sizeof(error_buf));
    
    if (module == NULL) {
        LOG_ERR("Failed to load WASM module: %s", error_buf);
        return -1;
    }

    /* Store module in registry */
    modules[slot].id = next_module_id++;
    modules[slot].module = module;
    modules[slot].in_use = true;

    *module_id = modules[slot].id;
    LOG_INF("WASM module loaded (module_id: %u)", *module_id);

    return 0;
}

/* Instantiate WASM module */
int wamr_instantiate(uint32_t module_id, uint32_t *instance_id)
{
    if (!wamr_initialized) {
        LOG_ERR("WAMR not initialized");
        return -1;
    }

    LOG_INF("Instantiating WASM module (module_id: %u)...", module_id);

    /* Find module */
    wasm_module_t module = NULL;
    int module_slot = -1;
    for (int i = 0; i < MAX_MODULES; i++) {
        if (modules[i].in_use && modules[i].id == module_id) {
            module = modules[i].module;
            module_slot = i;
            break;
        }
    }
    
    if (module == NULL) {
        LOG_ERR("Module not found: %u", module_id);
        return -1;
    }

    /* Find free instance slot */
    int slot = -1;
    for (int i = 0; i < MAX_INSTANCES; i++) {
        if (!instances[i].in_use) {
            slot = i;
            break;
        }
    }
    
    if (slot < 0) {
        LOG_ERR("No free instance slots");
        return -1;
    }

    uint32_t stack_size = 16 * 1024;
    uint32_t heap_size = 0;

    /* Error buffer for WAMR */
    static char error_buf[128];
    error_buf[0] = '\0';

#if WASM_ENABLE_LIBC_WASI != 0
    /* Set minimal WASI args: no dirs, no env, argv = {"app"}.
     * Required so WAMR can resolve proc_exit / fd_write / environ_sizes_get.
     * Without this call the module may trap on first WASI import call. */
    /* No dir preopens: Zephyr's FS layer rejects "/" (no real mount),
     * and WASI modules that only use proc_exit/fd_write don't need them. */
    static const char *wasi_env_list[]  = {NULL};
    static const char *wasi_argv_list[] = {"app"};
    wasm_runtime_set_wasi_args(module,
                               NULL, 0,
                               NULL, 0,
                               wasi_env_list, 0,
                               (char **)wasi_argv_list, 1);
    LOG_DBG("WASI args set on module %u", module_id);
#endif

    /* Instantiate WASM module */
    wasm_module_inst_t instance = wasm_runtime_instantiate(module, stack_size,
                                                           heap_size, error_buf,
                                                           sizeof(error_buf));
    
    if (instance == NULL) {
        LOG_ERR("Failed to instantiate WASM module: %s", error_buf);
        return -1;
    }

    /* Create execution environment */
    wasm_exec_env_t exec_env = wasm_runtime_create_exec_env(instance, stack_size);
    if (exec_env == NULL) {
        LOG_ERR("Failed to create execution environment");
        wasm_runtime_deinstantiate(instance);
        return -1;
    }

    /* Store instance in registry */
    instances[slot].id = next_instance_id++;
    instances[slot].instance = instance;
    instances[slot].exec_env = exec_env;
    instances[slot].in_use = true;
    instances[slot].instruction_limit_hit = false;

#if WASM_ENABLE_INSTRUCTION_METERING != 0
    wasm_runtime_set_instruction_count_limit(exec_env, WAMR_INSTRUCTION_LIMIT);
    LOG_DBG("Instruction limit set to %u for instance %u", WAMR_INSTRUCTION_LIMIT, instances[slot].id);
#else
    LOG_WRN("Instruction metering not compiled into this WAMR build "
            "(WASM_ENABLE_INSTRUCTION_METERING==0) — no instruction budget enforced");
#endif

    *instance_id = instances[slot].id;
    LOG_INF("WASM module instantiated (instance_id: %u)", *instance_id);

    return 0;
}

/* Execute WASM function */
int wamr_call_function(uint32_t instance_id, const char *function_name,
                       uint32_t *args, uint32_t args_count, uint32_t *results, uint32_t results_count)
{
    if (!wamr_initialized) {
        LOG_ERR("WAMR not initialized");
        return -1;
    }

    LOG_INF("Calling WASM function: %s (instance_id: %u)", function_name, instance_id);

    /* Find instance */
    int slot_idx = -1;
    wasm_module_inst_t instance = NULL;
    wasm_exec_env_t exec_env = NULL;
    for (int i = 0; i < MAX_INSTANCES; i++) {
        if (instances[i].in_use && instances[i].id == instance_id) {
            instance = instances[i].instance;
            exec_env = instances[i].exec_env;
            slot_idx = i;
            break;
        }
    }

    if (instance == NULL || exec_env == NULL) {
        LOG_ERR("Instance not found: %u", instance_id);
        return -1;
    }

    /* Find function */
    wasm_function_inst_t function = wasm_runtime_lookup_function(instance, function_name);
    if (function == NULL) {
        LOG_ERR("Function not found: %s", function_name);
        return -1;
    }

    /* Call WASM function - wasm_runtime_call_wasm takes argc and argv array */
    /* Note: Results are stored in the WASM stack and can be read using
     * wasm_runtime_get_function_ret_value or similar APIs if needed */
    if (!wasm_runtime_call_wasm(exec_env, function, args_count, args)) {
        const char *exception = wasm_runtime_get_exception(instance);
        bool limit_hit = exception != NULL
            && strstr(exception, WAMR_INSTRUCTION_LIMIT_EXCEPTION_SUBSTR) != NULL;
        if (slot_idx >= 0) {
            instances[slot_idx].instruction_limit_hit = limit_hit;
        }
        if (exception) {
            LOG_ERR("WASM exception: %s%s", exception, limit_hit ? " (instruction limit hit)" : "");
        } else {
            LOG_ERR("Failed to call WASM function: %s", function_name);
        }
        return -1;
    }

    if (slot_idx >= 0) {
        instances[slot_idx].instruction_limit_hit = false;
    }

    /* TODO: Read return values from WASM stack if results_count > 0
     * For now, results parameter is ignored as WAMR stores results differently
     * This can be enhanced later if needed for specific use cases */

    LOG_INF("WASM function executed: %s", function_name);

    return 0;
}

/*
 * Call the WASI _start entry point of a module instance.
 * WASI command modules export "_start" (not "main" or "run").
 * Falls back to looking for "run" for non-WASI modules.
 * Returns 0 on success (including proc_exit(0)), -1 on error.
 */
int wamr_call_wasi_start(uint32_t instance_id)
{
    if (!wamr_initialized) {
        LOG_ERR("WAMR not initialized");
        return -1;
    }

    int slot_idx = -1;
    wasm_module_inst_t instance = NULL;
    wasm_exec_env_t exec_env = NULL;
    for (int i = 0; i < MAX_INSTANCES; i++) {
        if (instances[i].in_use && instances[i].id == instance_id) {
            instance = instances[i].instance;
            exec_env = instances[i].exec_env;
            slot_idx = i;
            break;
        }
    }

    if (instance == NULL || exec_env == NULL) {
        LOG_ERR("Instance not found: %u", instance_id);
        return -1;
    }

#if WASM_ENABLE_LIBC_WASI != 0
    /* Prefer WASI-aware start: handles proc_exit correctly */
    wasm_function_inst_t start = wasm_runtime_lookup_wasi_start_function(instance);
    if (start != NULL) {
        LOG_INF("Calling WASI _start (instance %u)", instance_id);
        if (!wasm_runtime_call_wasm(exec_env, start, 0, NULL)) {
            /* proc_exit() always surfaces as "wasi proc exit" exception in WAMR.
             * Distinguish success (exit_code == 0) from failure via the WASI API. */
            const char *ex = wasm_runtime_get_exception(instance);
            if (ex != NULL && strstr(ex, "wasi proc exit") != NULL) {
                uint32_t exit_code = wasm_runtime_get_wasi_exit_code(instance);
                wasm_runtime_clear_exception(instance);
                if (slot_idx >= 0) {
                    instances[slot_idx].instruction_limit_hit = false;
                }
                if (exit_code == 0) {
                    LOG_INF("WASI module exited cleanly (proc_exit 0)");
                    return 0;
                }
                LOG_ERR("WASI module exited with error (proc_exit %u)", exit_code);
                return -1;
            }
            bool limit_hit = ex != NULL
                && strstr(ex, WAMR_INSTRUCTION_LIMIT_EXCEPTION_SUBSTR) != NULL;
            if (slot_idx >= 0) {
                instances[slot_idx].instruction_limit_hit = limit_hit;
            }
            LOG_ERR("WASI _start failed: %s%s", ex ? ex : "(unknown)", limit_hit ? " (instruction limit hit)" : "");
            return -1;
        }
        if (slot_idx >= 0) {
            instances[slot_idx].instruction_limit_hit = false;
        }
        return 0;
    }
#endif

    /* Fallback: non-WASI module exporting "run" */
    wasm_function_inst_t run_fn = wasm_runtime_lookup_function(instance, "run");
    if (run_fn != NULL) {
        LOG_INF("Calling 'run' (instance %u)", instance_id);
        if (!wasm_runtime_call_wasm(exec_env, run_fn, 0, NULL)) {
            const char *ex = wasm_runtime_get_exception(instance);
            bool limit_hit = ex != NULL
                && strstr(ex, WAMR_INSTRUCTION_LIMIT_EXCEPTION_SUBSTR) != NULL;
            if (slot_idx >= 0) {
                instances[slot_idx].instruction_limit_hit = limit_hit;
            }
            LOG_ERR("'run' failed: %s%s", ex ? ex : "(unknown)", limit_hit ? " (instruction limit hit)" : "");
            return -1;
        }
        if (slot_idx >= 0) {
            instances[slot_idx].instruction_limit_hit = false;
        }
        return 0;
    }

    LOG_ERR("No entry point found (_start / run) in instance %u", instance_id);
    return -1;
}

/* See wamr_integration.h for the contract. */
bool wamr_last_call_hit_instruction_limit(uint32_t instance_id)
{
    for (int i = 0; i < MAX_INSTANCES; i++) {
        if (instances[i].in_use && instances[i].id == instance_id) {
            return instances[i].instruction_limit_hit;
        }
    }
    return false;
}

/* Process WAMR runtime (call periodically) */
void wamr_process(void)
{
    if (!wamr_initialized) {
        return;
    }

    /* TODO: Process WAMR runtime events if needed */
}

/* Unload all running instances and loaded modules WITHOUT destroying the runtime.
 * Call this before deploying a new application so WAMR slots are recycled. */
void wamr_unload_all(void)
{
    if (!wamr_initialized) {
        return;
    }

    for (int i = 0; i < MAX_INSTANCES; i++) {
        if (instances[i].in_use) {
            if (instances[i].exec_env) {
                wasm_runtime_destroy_exec_env(instances[i].exec_env);
                instances[i].exec_env = NULL;
            }
            if (instances[i].instance) {
                wasm_runtime_deinstantiate(instances[i].instance);
                instances[i].instance = NULL;
            }
            instances[i].in_use = false;
        }
    }

    for (int i = 0; i < MAX_MODULES; i++) {
        if (modules[i].in_use) {
            if (modules[i].module) {
                wasm_runtime_unload(modules[i].module);
                modules[i].module = NULL;
            }
            modules[i].in_use = false;
        }
    }

    LOG_INF("WAMR: all instances and modules unloaded");
}

/* Cleanup WAMR runtime */
void wamr_cleanup(void)
{
    if (!wamr_initialized) {
        return;
    }

    LOG_INF("Cleaning up WAMR runtime...");

    /* Cleanup all instances */
    for (int i = 0; i < MAX_INSTANCES; i++) {
        if (instances[i].in_use) {
            if (instances[i].exec_env) {
                wasm_runtime_destroy_exec_env(instances[i].exec_env);
            }
            if (instances[i].instance) {
                wasm_runtime_deinstantiate(instances[i].instance);
            }
            instances[i].in_use = false;
        }
    }

    /* Cleanup all modules */
    for (int i = 0; i < MAX_MODULES; i++) {
        if (modules[i].in_use) {
            if (modules[i].module) {
                wasm_runtime_unload(modules[i].module);
            }
            modules[i].in_use = false;
        }
    }

    /* Destroy WAMR runtime */
    wasm_runtime_destroy();

    wamr_initialized = false;
    LOG_INF("WAMR runtime cleaned up");
}
```

## src/wamr_integration.h
```c
/*
 * SPDX-License-Identifier: Apache-2.0
 * Copyright © 2025 Wasmbed contributors
 *
 * WAMR Integration Layer
 * Interface for WebAssembly Micro Runtime
 */

#ifndef WAMR_INTEGRATION_H
#define WAMR_INTEGRATION_H

#include <stdint.h>
#include <stdbool.h>

/* Initialize WAMR runtime */
int wamr_init(void);

/* Load WASM module from bytes */
int wamr_load_module(const uint8_t *wasm_bytes, uint32_t wasm_size, uint32_t *module_id);

/* Instantiate WASM module */
int wamr_instantiate(uint32_t module_id, uint32_t *instance_id);

/* Execute WASM function by name */
int wamr_call_function(uint32_t instance_id, const char *function_name,
                       uint32_t *args, uint32_t args_count, uint32_t *results, uint32_t results_count);

/* Call WASI _start entry point (falls back to "run" for non-WASI modules) */
int wamr_call_wasi_start(uint32_t instance_id);

/*
 * Instruction metering: WAMR's equivalent of Wasmtime's fuel API, enabled by
 * WAMR_BUILD_INSTRUCTION_METERING in CMakeLists.txt. Every instance gets a
 * fixed instruction budget at wamr_instantiate() time (see
 * WAMR_INSTRUCTION_LIMIT in wamr_integration.c) — this is a computational
 * proxy for comparing workloads, not a time or energy measurement. Correlate
 * with Kepler energy readings over the same wall-clock window if you need to
 * relate it to power (see k8s/monitoring/README.md).
 *
 * True if the most recently completed call on this instance failed because
 * it hit the configured instruction limit, as opposed to any other trap
 * (WASI proc_exit, illegal instruction, out-of-bounds access, ...). Best
 * effort: implemented by matching the WAMR exception string, the same
 * technique wamr_call_wasi_start() already uses for "wasi proc exit" — see
 * the implementation comment for how to confirm the exact string against
 * the vendored WAMR revision.
 */
bool wamr_last_call_hit_instruction_limit(uint32_t instance_id);

/* Process WAMR runtime (call periodically) */
void wamr_process(void);

/* Unload all instances and modules, keeping the runtime alive (for re-use) */
void wamr_unload_all(void);

/* Cleanup WAMR runtime */
void wamr_cleanup(void);

#endif /* WAMR_INTEGRATION_H */
```
